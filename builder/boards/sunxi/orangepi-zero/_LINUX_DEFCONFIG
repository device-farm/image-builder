## builder/layers/base/linux-defconfig
```kconfig
######## base layer ########

# We compile monolithic kernel 
CONFIG_MODULES=n
CONFIG_MODULE_UNLOAD=n

# Enable SMP by default
CONFIG_SMP=y

# Enable firmware support
CONFIG_FW_LOADER=y
CONFIG_EXTRA_FIRMWARE_DIR="/build/firmware"

# No IPv6 yet
CONFIG_IPV6=n

# This causes compilation problems in 5.x on some platforms
CONFIG_NET_VENDOR_MELLANOX=n
```

## builder/layers/xradio/linux/drivers/net/wireless/xradio/Kconfig
```kconfig
config XRADIO
       bool "XRADIO WLAN support"
       depends on MAC80211
       default n

if XRADIO

config XRADIO_NON_POWER_OF_TWO_BLOCKSIZES
	bool "Platform supports non-power-of-two SDIO transfer"
	depends on XRADIO
	default y

config XRADIO_5GHZ_SUPPORT
	bool "5GHz band support"
	depends on XRADIO
	default n

config XRADIO_WAPI_SUPPORT
	bool "WAPI support"
	depends on XRADIO
	default n

config XRADIO_USE_EXTENSIONS
	bool "Extensions for WFD and PS mode"
	depends on XRADIO
	default y

endif
```

## layers/base/linux-defconfig
```kconfig
######## base layer ########

# We compile monolithic kernel
CONFIG_MODULES=n
CONFIG_MODULE_UNLOAD=n

# Enable SMP by default
CONFIG_SMP=y

# Enable firmware support
CONFIG_FW_LOADER=y
CONFIG_EXTRA_FIRMWARE_DIR="/build/firmware"
```
